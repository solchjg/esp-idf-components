## components/ble_setup/Kconfig
```kconfig
menu "BLE setup"

    config BLE_SETUP_BODY_MAX
        int "Largest settings body (bytes)"
        default 2048
        range 512 4096
        help
            The staged settings body (several writes) and the settings read
            are cut off at this size; a longer staged body is refused. Match
            the portal's PORTAL_BODY_MAX so both accept the same forms.

    config BLE_SETUP_ADV_INTERVAL_MS
        int "Advertising interval (ms)"
        default 160
        range 20 10240
        help
            Shorter is found faster by a phone and uses more airtime, which
            WiFi shares.

endmenu
```

## components/button/Kconfig
```kconfig
menu "Button"

    config BUTTON_GPIO
        int "Button GPIO (active low, internal pull-up)"
        range 0 48
        default 0
        help
            GPIO 0 is the BOOT button on the T-Display-S3 and most ESP32-S3
            boards.

endmenu
```

## components/deep_sleep/Kconfig
```kconfig
menu "Deep sleep"

    config DEEP_SLEEP_MIN_S
        int "Shortest sleep period (s)"
        range 1 86400
        default 1

    config DEEP_SLEEP_MAX_S
        int "Longest sleep period (s)"
        range 1 31536000
        default 86400

    config DEEP_SLEEP_WAKE_GPIO
        int "Active-low GPIO that also wakes the chip (-1: timer only)"
        range -1 21
        default -1
        help
            Must be an RTC GPIO (0 - 21 on the ESP32-S3). On the T-Display-S3
            AMOLED the second key is GPIO 21. GPIO 0 (BOOT) is a strapping pin:
            avoid it.

    config DEEP_SLEEP_WAKE_PULLUP
        bool "Pull the wake GPIO up internally during sleep"
        depends on DEEP_SLEEP_WAKE_GPIO >= 0
        default y
        help
            Turn off when the board has its own pull-up on the pin.

endmenu
```

## components/identity/Kconfig
```kconfig
menu "Device identity"

    config IDENTITY_SOFTAP_SSID_PREFIX
        string "SoftAP SSID prefix"
        default "TDS3-"
        help
            The provisioning SoftAP is named this prefix followed by the last
            three base-MAC bytes in upper-case hex (FSD FR-13.1). Prefix and
            hex together are cut to 15 characters.

    config IDENTITY_HOSTNAME_PREFIX
        string "Hostname prefix"
        default "tds3-"
        help
            The DHCP and mDNS hostname is this prefix followed by the same
            three bytes in lower-case hex (FSD FR-20.1). Use only letters,
            digits and '-'. Prefix and hex together are cut to 15 characters.

endmenu
```

## components/portal/Kconfig
```kconfig
menu "Provisioning portal"

    config PORTAL_PAGE_TITLE
        string "Page title"
        default "TDS3 setup"
        help
            The <title> of the WiFi setup form and of its confirmation page.
            Plain text: no quotes or markup.

    config PORTAL_BODY_MAX
        int "Largest form submission (bytes)"
        default 1024
        range 256 4096
        help
            A longer POST /connect body is answered 400. Room for the WiFi
            fields and any extra fields the app adds, percent-encoded.

    config PORTAL_WIFI_SWITCH
        bool "WiFi on/off switch in the form"
        default n
        help
            Adds a `wifi` choice (On / Off) before the network name. With
            Off the network name and password are optional, and the
            submission is checked by pc_parse_wifi; the app reads `wifi`
            itself (pc_field) and decides what Off means.

endmenu
```

## components/time_sync/Kconfig
```kconfig
menu "Time sync"

    config TIME_SYNC_SERVER
        string "SNTP server"
        default "pool.ntp.org"

    config TIME_SYNC_TZ
        string "Time zone (POSIX TZ string)"
        default "UTC0"
        help
            For example "CET-1CEST,M3.5.0,M10.5.0/3" for Central Europe or
            "EST5EDT,M3.2.0,M11.1.0" for US Eastern.

endmenu
```

## components/udp_log/Kconfig
```kconfig
menu "UDP log"

    config UDP_LOG_PORT
        int "Destination UDP port"
        range 1 65535
        default 5555
        help
            The mirrored log lines go to this port on the address passed to
            udp_log_start (FSD §16).

    config UDP_LOG_TAG
        string "Log tag to mirror"
        default "web"
        help
            Only lines of this esp_log tag at level I, W or E are sent,
            starting at the tag (FSD FR-16.1, FR-16.2).

endmenu
```

## components/wifi_net/Kconfig
```kconfig
menu "WiFi network"

    config WIFI_NET_SOFTAP_CHANNEL
        int "SoftAP channel"
        range 1 13
        default 1
        help
            Channel of the open provisioning SoftAP (FSD FR-13.1).

    config WIFI_NET_SOFTAP_MAX_CLIENTS
        int "SoftAP client limit"
        range 1 10
        default 4

    config WIFI_NET_NVS_NAMESPACE
        string "NVS namespace for the stored credentials"
        default "net"
        help
            At most 15 characters. Changing it orphans credentials stored
            under the old namespace.

endmenu
```
